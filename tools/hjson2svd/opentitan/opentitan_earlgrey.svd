# earlgrey register map
File version: 0.1
Address unit: 32 bits
Registers are 32-bit, read-write, no defined reset value unless marked. A register's access mark holds for its fields unless they carry their own. Offsets are from the block's base; lines under a group give offsets from that group; [hi:lo] are bit positions; {n}, {i} and the like mark numbered series; 'fields as' and 'values as' point back to an identical list; <NAME> marks a mode.

## Memory map
0x40000000 uart0 blocks up to offset 0x40000120 — Full duplex serial communication interface, supports bit rates of up to 1 Mbit/s
0x40010000 uart1 blocks up to offset 0x40010120 — Full duplex serial communication interface, supports bit rates of up to 1 Mbit/s
0x40020000 uart2 blocks up to offset 0x40020120 — Full duplex serial communication interface, supports bit rates of up to 1 Mbit/s
0x40030000 uart3 blocks up to offset 0x40030120 — Full duplex serial communication interface, supports bit rates of up to 1 Mbit/s
0x40040000 gpio blocks up to offset 0x40040180 — General-purpose I/O pin control interface for software
0x40080000 i2c0 blocks up to offset 0x40080240 — I2C interface for host and device mode, supporting up to 1 Mbaud data rates
0x40090000 i2c1 blocks up to offset 0x40090240 — I2C interface for host and device mode, supporting up to 1 Mbaud data rates
0x400A0000 i2c2 blocks up to offset 0x400A0240 — I2C interface for host and device mode, supporting up to 1 Mbaud data rates
0x40420000 clkmgr_aon blocks up to offset 0x40420060 — Derives and monitors on-chip clock signals, handles clock gating requests from power manager and software
0x40470000 aon_timer_aon blocks up to offset 0x40470160 — Wakeup and watchdog timers running on a low-power, always-on clock
0x41150000 csrng blocks up to offset 0x411501A0 — Takes entropy bits to produce cryptographically secure random numbers for consumption by hardware blocks and by software
0x41160000 entropy_src blocks up to offset 0x411606A0 — Filters and checks raw entropy bits from a random noise source and forwards them to CSRNG
0x41170000 edn0 blocks up to offset 0x411701A0 — Distributes random numbers produced by CSRNG to hardware blocks
0x41180000 edn1 blocks up to offset 0x411801A0 — Distributes random numbers produced by CSRNG to hardware blocks

## Interrupts
0 acq_full (i2c{n} (n=0..2)) — target mode interrupt: raised if ACQ FIFO becomes full. This is a level status interrupt.
0 cmd_complete (i2c{n} (n=0..2)) — host and target mode interrupt.In host mode, raised if the host issues a repated START or terminates the transaction by issuing STOP.In target mode, raised if the external host issues a STOP or repeated START.
0 cs_cmd_req_done (csrng) — Asserted when a command request is completed.
0 cs_entropy_req (csrng) — Asserted when a request for entropy has been made.
0 cs_fatal_err (csrng) — Asserted when a FIFO error or a fatal alert occurs. Check the !!ERR_CODE register to get more information.
0 cs_hw_inst_exc (csrng) — Asserted when a hardware-attached CSRNG instance encounters a command exception
0 edn_cmd_req_done (edn0, edn1) — Asserted when a software CSRNG request has completed.
0 edn_fatal_err (edn0, edn1) — Asserted when a FIFO error occurs.
0 es_entropy_valid (entropy_src) — Asserted when entropy source bits are available.
0 es_fatal_err (entropy_src) — Asserted when a FIFO error occurs, or if an illegal state machine state is reached.
0 es_health_test_failed (entropy_src) — Asserted when the alert count has been met.
0 es_observe_fifo_ready (entropy_src) — Asserted when the observe FIFO has filled to the threshold level.
0 fmt_overflow (i2c{n} (n=0..2)) — host mode interrupt: raised if the FMT FIFO has overflowed.
0 fmt_threshold (i2c{n} (n=0..2)) — host mode interrupt: raised when the FMT FIFO depth is less than the low threshold.
0 gpio — raised if any of GPIO pin detects configured interrupt mode
0 host_timeout (i2c{n} (n=0..2)) — target mode interrupt: raised if the host stops sending the clock during an ongoing transaction.
0 nak (i2c{n} (n=0..2)) — host mode interrupt: raised if there is no ACK in response to an address or data write
0 rx_break_err (uart{n} (n=0..3)) — raised if break condition has been detected on receive.
0 rx_frame_err (uart{n} (n=0..3)) — raised if a framing error has been detected on receive.
0 rx_overflow (uart{n} (n=0..3), i2c{n} (n=0..2)) — raised if the receive FIFO has overflowed.
0 rx_parity_err (uart{n} (n=0..3)) — raised if the receiver has detected a parity error.
0 rx_threshold (i2c{n} (n=0..2)) — host mode interrupt: raised if the RX FIFO is greater than the high threshold.
0 rx_timeout (uart{n} (n=0..3)) — raised if RX FIFO has characters remaining in the FIFO without beingretrieved for the programmed time period.
0 rx_watermark (uart{n} (n=0..3)) — raised if the receive FIFO is past the high-water mark.
0 scl_interference (i2c{n} (n=0..2)) — host mode interrupt: raised if the SCL line drops early (not supported without clock synchronization).
0 sda_interference (i2c{n} (n=0..2)) — host mode interrupt: raised if the SDA line goes low when host is trying to assert high
0 sda_unstable (i2c{n} (n=0..2)) — host mode interrupt: raised if the target does not assert a constant value of SDA during transmission.
0 stretch_timeout (i2c{n} (n=0..2)) — host mode interrupt: raised if target stretches the clock beyond the allowed timeout period
0 tx_empty (uart{n} (n=0..3)) — raised if the transmit FIFO has emptied and no transmit is ongoing.
0 tx_overflow (i2c{n} (n=0..2)) — target mode interrupt: raised if TX FIFO has overflowed.
0 tx_stretch (i2c{n} (n=0..2)) — target mode interrupt: raised if the target is stretching clocks for a read command. This is a level status interrupt.
0 tx_watermark (uart{n} (n=0..3)) — raised if the transmit FIFO is past the high-water mark.
0 unexp_stop (i2c{n} (n=0..2)) — target mode interrupt: raised if STOP is received without a preceding NACK during an external host read.
0 wdog_timer_bark (aon_timer_aon) — Raised if the watchdog timer has hit the bark threshold
0 wkup_timer_expired (aon_timer_aon) — Raised if the wakeup timer has hit the specified threshold
